## components/cmd_sdcard/Kconfig.projbuild
```kconfig
menu "SD card operation config menu"

    config EXAMPLE_FORMAT_IF_MOUNT_FAILED
        bool "Format the card if mount failed"
        default n
        help
            If this config item is set, format_if_mount_failed will be set to true and the card will be formatted if
            the mount has failed.

    config AUTO_CHDIR_BEHIND_MOUNTING
        bool "Auto change dir after mount SD-card"
        default n
        help
            Change default directory (pwd) after mounting the SD-card.

    config DIRECTORY_FOR_AUTOCHANGE
        string "Directory for auto-change after SD-card mounting"
        depends on AUTO_CHDIR_BEHIND_MOUNTING
        default SD_MOUNT_POINT
        help
            Directory to jump after mounting.
endmenu
```
