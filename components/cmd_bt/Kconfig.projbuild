## components/cmd_bt/Kconfig.projbuild
```kconfig
menu "BT SPP Server Configuration"
    depends on BT_CLASSIC_ENABLED
    config EXAMPLE_SSP_ENABLED
        bool "Secure Simple Pairing"
        depends on BT_CLASSIC_ENABLED
        default y
        help
            This enables the Secure Simple Pairing. If disable this option,
            Bluedroid will only support Legacy Pairing

    config BT_LOCAL_DEVICE_NAME
        string "Bluetooth Local Device Name"
        default "ESP_Console_SPP_ACCEPTOR"
        help
            Use this option to set local device name.
endmenu
```

## main/Kconfig.projbuild
```kconfig
menu "Improved ESP32 Console"

    config CONSOLE_STORE_HISTORY
        bool "Store command history in flash"
        default n
        help
            Linenoise line editing library provides functions to save and load
            command history. If this option is enabled, initializes a FAT filesystem
            and uses it to store command history.

    config CONSOLE_IGNORE_EMPTY_LINES
        bool "Ignore empty lines inserted into the console"
        default y
        help
            If an empty line is inserted to the console, the Console can either
            ignore empty lines (the example would continue), or break on empty lines
            (the example would stop after an empty line).


    menu "Version management"

        config APP_PROJECT_VER
        string "Project version"
#        depends on APP_PROJECT_VER_FROM_CONFIG
        help
            Project version

        config APP_PROJECT_FLAVOUR
        string "Flavour of the current project branch"
#        depends on APP_PROJECT_VER_FROM_CONFIG
        help
            Variant of the project application

        config APP_PROJECT_DATE
        string "Current project version date"
#        depends on APP_PROJECT_VER_FROM_CONFIG
        help
            Date of the project current version

        config APP_PROJECT_AUTHOR
        string "Author (modificator) of the current project version"
#        depends on APP_PROJECT_VER_FROM_CONFIG
        help
            The person, who made changes of the current version
            in the source code of the project

        config APP_PROJECT_AUTHOR_NICK
        string "Nickname of the author"
        help
            Nickname (short name aka alias) of the Author, who made modify source code
            of the current version this project

    endmenu # Version management

endmenu	# Improved ESP32 Console
```

## sdkconfig.defaults
```kconfig
# Reduce bootloader log verbosity
CONFIG_BOOTLOADER_LOG_LEVEL_WARN=y
CONFIG_BOOTLOADER_LOG_LEVEL=2

# Increase main task stack size
CONFIG_ESP_MAIN_TASK_STACK_SIZE=7168

# Enable filesystem
CONFIG_PARTITION_TABLE_CUSTOM=y
CONFIG_PARTITION_TABLE_CUSTOM_FILENAME="partitions_console.csv"
CONFIG_PARTITION_TABLE_FILENAME="partitions_console.csv"

# Enable FreeRTOS stats formatting functions, needed for 'tasks' command
CONFIG_FREERTOS_USE_TRACE_FACILITY=y
CONFIG_FREERTOS_USE_STATS_FORMATTING_FUNCTIONS=y

CONFIG_ESPTOOLPY_FLASHSIZE_4MB=y

# Project version
CONFIG_APP_PROJECT_VER_FROM_CONFIG=y
CONFIG_APP_PROJECT_VER="2.2.10.4"
CONFIG_APP_PROJECT_DATE="20.02.25"
CONFIG_APP_PROJECT_FLAVOUR="bluetooth-explore"
CONFIG_APP_PROJECT_AUTHOR="Solomatov A.A."
CONFIG_APP_PROJECT_AUTHOR_NICK="aso"

# CXX options - Exceptions & RTTI options
CONFIG_COMPILER_CXX_EXCEPTIONS=y
CONFIG_COMPILER_CXX_EXCEPTIONS_EMG_POOL_SIZE=1024
CONFIG_COMPILER_CXX_RTTI=y

# ESP HTTP client options
CONFIG_ESP_HTTP_CLIENT_ENABLE_DIGEST_AUTH=y

# PHY options
CONFIG_ESP_PHY_REDUCE_TX_POWER=y

# IPC (Inter-Processor Call) options
CONFIG_ESP_IPC_TASK_STACK_SIZE=1536

# FAT Filesystem support options
CONFIG_FATFS_CODEPAGE_866=y
CONFIG_FATFS_CODEPAGE=866
CONFIG_FATFS_LFN_STACK=y
CONFIG_FATFS_MAX_LFN=255
CONFIG_FATFS_API_ENCODING_UTF_8=y

# Host File System I/O (Semihosting) options
CONFIG_VFS_SEMIHOSTFS_MAX_MOUNT_POINTS=2

# Wi-Fi Provisioning Manager
CONFIG_WIFI_PROV_BLE_FORCE_ENCRYPTION=y

# Storage configuration options
CONFIG_AUTO_CHDIR_BEHIND_MOUNTING=y
CONFIG_DIRECTORY_FOR_AUTOCHANGE="SD_MOUNT_POINT"
```
